/*
 * Generated by ESP-IDF BLE GATT Configurator
 * Date: 2026-05-24
 * Device: ESP32_BLE
 */

#include <string.h>
#include <inttypes.h>
#include "freertos/FreeRTOS.h"
#include "freertos/task.h"
#include "freertos/event_groups.h"
#include "esp_system.h"
#include "esp_log.h"
#include "esp_bt.h"
#include "esp_gap_ble_api.h"
#include "esp_gatts_api.h"
#include "esp_bt_defs.h"
#include "esp_bt_main.h"
#include "esp_gatt_common_api.h"
#include "nvs_flash.h"

#define TAG           "BLE_GATT"
#define DEVICE_NAME   "ESP32_BLE"
#define APP_ID        0x00
#define SERVICE_COUNT 2

/* ── GATT Attribute Counts ── */
#define GATTS_NUM_HANDLES_SVC_0  3
#define GATTS_NUM_HANDLES_SVC_1  3

enum {
    SVC_0_IDX_SERVICE,
    SVC_0_IDX_CHAR_0_DECL,
    SVC_0_IDX_CHAR_0_VAL,
    SVC_0_IDX_NB,
};
static uint16_t gatts_handle_table_svc0[GATTS_NUM_HANDLES_SVC_0];

enum {
    SVC_1_IDX_SERVICE,
    SVC_1_IDX_CHAR_0_DECL,
    SVC_1_IDX_CHAR_0_VAL,
    SVC_1_IDX_NB,
};
static uint16_t gatts_handle_table_svc1[GATTS_NUM_HANDLES_SVC_1];

static uint8_t MY_CHARACTERISTIC_S0C0_VAL[5] = {0x73, 0x68, 0x75, 0x76, 0x61};
static const uint8_t CHAR_PROP_S0C0 = ESP_GATT_CHAR_PROP_BIT_READ | ESP_GATT_CHAR_PROP_BIT_WRITE;
static uint8_t MY_CHARACTERISTIC_S1C0_VAL[1] = {0x00};
static const uint8_t CHAR_PROP_S1C0 = 0;

static const uint8_t SVC_UUID_0[16] = {0xF1, 0x49, 0xA9, 0x39, 0x11, 0x6A, 0xBD, 0xBC, 0xC6, 0x4E, 0xBD, 0x47, 0x1D, 0xB1, 0x21, 0x3E};
static const uint8_t CHAR_UUID_0_0[16] = {0x4C, 0xA7, 0x0C, 0x4B, 0x69, 0x57, 0xF4, 0xAF, 0xD8, 0x49, 0xDC, 0x89, 0x67, 0x2B, 0x9E, 0x3E};
static const uint8_t SVC_UUID_1[16] = {0x3D, 0xB5, 0x7A, 0x5D, 0x81, 0xF9, 0x32, 0xB5, 0xEE, 0x40, 0x8B, 0xAB, 0x48, 0xA7, 0x4B, 0x5F};
static const uint8_t CHAR_UUID_1_0[16] = {0x98, 0x6C, 0xBC, 0xFA, 0x31, 0xA2, 0x9D, 0xB7, 0x2B, 0x48, 0x60, 0xD1, 0xCD, 0x77, 0x21, 0x3C};

/* ── Standard UUID variables (macros cannot be addressed directly) ── */
static const uint16_t UUID_PRI_SERVICE     = ESP_GATT_UUID_PRI_SERVICE;
static const uint16_t UUID_CHAR_DECLARE    = ESP_GATT_UUID_CHAR_DECLARE;

/* Service 0: My Service */
static const esp_gatts_attr_db_t gatts_db_svc0[] = {
    /* Service Declaration */
    {{ESP_GATT_AUTO_RSP}, {ESP_UUID_LEN_16, (uint8_t*)&UUID_PRI_SERVICE,
      ESP_GATT_PERM_READ, sizeof(SVC_UUID_0), sizeof(SVC_UUID_0), (uint8_t*)SVC_UUID_0}},
    /* Characteristic 0: My Characteristic */
    /* Char Declaration */
    {{ESP_GATT_AUTO_RSP}, {ESP_UUID_LEN_16, (uint8_t*)&UUID_CHAR_DECLARE,
      ESP_GATT_PERM_READ, sizeof(uint8_t), sizeof(uint8_t),
      (uint8_t*)&CHAR_PROP_S0C0}},
    /* Char Value */
    {{ESP_GATT_AUTO_RSP}, {ESP_UUID_LEN_128, (uint8_t*)CHAR_UUID_0_0,
      ESP_GATT_PERM_READ | ESP_GATT_PERM_WRITE, 5, 5, (uint8_t*)MY_CHARACTERISTIC_S0C0_VAL}},
};

/* Service 1: My Service */
static const esp_gatts_attr_db_t gatts_db_svc1[] = {
    /* Service Declaration */
    {{ESP_GATT_AUTO_RSP}, {ESP_UUID_LEN_16, (uint8_t*)&UUID_PRI_SERVICE,
      ESP_GATT_PERM_READ, sizeof(SVC_UUID_1), sizeof(SVC_UUID_1), (uint8_t*)SVC_UUID_1}},
    /* Characteristic 0: My Characteristic */
    /* Char Declaration */
    {{ESP_GATT_AUTO_RSP}, {ESP_UUID_LEN_16, (uint8_t*)&UUID_CHAR_DECLARE,
      ESP_GATT_PERM_READ, sizeof(uint8_t), sizeof(uint8_t),
      (uint8_t*)&CHAR_PROP_S1C0}},
    /* Char Value */
    {{ESP_GATT_AUTO_RSP}, {ESP_UUID_LEN_128, (uint8_t*)CHAR_UUID_1_0,
      ESP_GATT_PERM_READ, 1, 1, (uint8_t*)MY_CHARACTERISTIC_S1C0_VAL}},
};

/* ── Advertising Parameters & Data (forward declarations) ── */
static esp_ble_adv_params_t adv_params;
static esp_ble_adv_data_t   adv_data;
static esp_ble_adv_data_t   scan_rsp_data;
static void init_adv_data(void);

/* Track when both adv_data and scan_rsp_data are configured */
static uint8_t s_adv_config_done = 0;
static uint8_t s_services_started = 0;
static uint8_t s_advertising_started = 0;
#define ADV_CONFIG_FLAG      (1 << 0)
#define SCAN_RSP_CONFIG_FLAG (1 << 1)

static void try_start_advertising(void) {
    if (!s_advertising_started &&
        s_adv_config_done == (ADV_CONFIG_FLAG | SCAN_RSP_CONFIG_FLAG) &&
        s_services_started >= SERVICE_COUNT) {
        esp_ble_gap_start_advertising(&adv_params);
        s_advertising_started = 1;
    }
}

static void handle_gatt_read(esp_ble_gatts_cb_param_t *param) {
    ESP_LOGI(TAG, "READ_EVT conn_id %d, trans_id %" PRIu32 ", handle %d",
             param->read.conn_id, param->read.trans_id, param->read.handle);
    int attr_matched = 0;
    if (param->read.handle == gatts_handle_table_svc0[SVC_0_IDX_CHAR_0_VAL]) {
        ESP_LOGI(TAG, "READ attr: svc0/My Service char0/My Characteristic, max_len %u", (unsigned)sizeof(MY_CHARACTERISTIC_S0C0_VAL));
        attr_matched = 1;
    }
    if (param->read.handle == gatts_handle_table_svc1[SVC_1_IDX_CHAR_0_VAL]) {
        ESP_LOGI(TAG, "READ attr: svc1/My Service char0/My Characteristic, max_len %u", (unsigned)sizeof(MY_CHARACTERISTIC_S1C0_VAL));
        attr_matched = 1;
    }
    if (!attr_matched) {
        ESP_LOGI(TAG, "READ attr: unknown handle %d", param->read.handle);
    }
}

static void handle_gatt_write(esp_ble_gatts_cb_param_t *param) {
    ESP_LOGI(TAG, "WRITE_EVT conn_id %d, trans_id %" PRIu32 ", handle %d, len %d",
             param->write.conn_id, param->write.trans_id,
             param->write.handle, param->write.len);
    if (param->write.len > 512) {
        ESP_LOGE(TAG, "Write too long (%d bytes), ignoring", param->write.len);
        /* Attributes use ESP_GATT_AUTO_RSP, so the stack sends the ATT response. */
        return;
    }
    int attr_matched = 0;
    if (param->write.handle == gatts_handle_table_svc0[SVC_0_IDX_CHAR_0_VAL]) {
        ESP_LOGI(TAG, "WRITE attr: svc0/My Service char0/My Characteristic, len %d", param->write.len);
        ESP_LOG_BUFFER_HEX(TAG, param->write.value, param->write.len);
        attr_matched = 1;
    }
    if (param->write.handle == gatts_handle_table_svc1[SVC_1_IDX_CHAR_0_VAL]) {
        ESP_LOGI(TAG, "WRITE attr: svc1/My Service char0/My Characteristic, len %d", param->write.len);
        ESP_LOG_BUFFER_HEX(TAG, param->write.value, param->write.len);
        attr_matched = 1;
    }
    if (!attr_matched) {
        ESP_LOGI(TAG, "WRITE attr: unknown handle %d", param->write.handle);
        ESP_LOG_BUFFER_HEX(TAG, param->write.value, param->write.len);
    }
    /* Attributes use ESP_GATT_AUTO_RSP, so no manual write response is sent here. */
}

/* GATTS Event Handler */
static void gatts_event_handler(esp_gatts_cb_event_t event,
                                 esp_gatt_if_t gatts_if,
                                 esp_ble_gatts_cb_param_t *param) {
    switch (event) {
    case ESP_GATTS_REG_EVT:
        ESP_LOGI(TAG, "REGISTER_APP_EVT, status %d, app_id %d",
                 param->reg.status, param->reg.app_id);
        if (param->reg.status != ESP_GATT_OK) {
            ESP_LOGE(TAG, "GATTS app registration failed, status %d", param->reg.status);
            break;
        }
        init_adv_data();
        esp_ble_gap_set_device_name(DEVICE_NAME);
        esp_ble_gap_config_adv_data(&adv_data);
        esp_ble_gap_config_adv_data(&scan_rsp_data);
        /* Register service 0: My Service */
        esp_ble_gatts_create_attr_tab(gatts_db_svc0, gatts_if,
            GATTS_NUM_HANDLES_SVC_0, 0);
        /* Register service 1: My Service */
        esp_ble_gatts_create_attr_tab(gatts_db_svc1, gatts_if,
            GATTS_NUM_HANDLES_SVC_1, 1);
        break;
    case ESP_GATTS_CREAT_ATTR_TAB_EVT:
        if (param->add_attr_tab.status != ESP_GATT_OK) {
            ESP_LOGE(TAG, "Create attr table failed for svc_inst_id %d, error 0x%x",
                     param->add_attr_tab.svc_inst_id, param->add_attr_tab.status);
            break;
        }
        /* Start the correct service based on which table was just registered */
        switch (param->add_attr_tab.svc_inst_id) {
        case 0: /* My Service */
            if (param->add_attr_tab.num_handle != GATTS_NUM_HANDLES_SVC_0) {
                ESP_LOGE(TAG, "Create attr table for svc0 abnormal, num_handle %d != %d",
                         param->add_attr_tab.num_handle, GATTS_NUM_HANDLES_SVC_0);
            } else {
                memcpy(gatts_handle_table_svc0, param->add_attr_tab.handles,
                       sizeof(gatts_handle_table_svc0));
                esp_ble_gatts_start_service(param->add_attr_tab.handles[0]);
                s_services_started++;
                try_start_advertising();
                ESP_LOGI(TAG, "Service 0 (My Service) started");
            }
            break;
        case 1: /* My Service */
            if (param->add_attr_tab.num_handle != GATTS_NUM_HANDLES_SVC_1) {
                ESP_LOGE(TAG, "Create attr table for svc1 abnormal, num_handle %d != %d",
                         param->add_attr_tab.num_handle, GATTS_NUM_HANDLES_SVC_1);
            } else {
                memcpy(gatts_handle_table_svc1, param->add_attr_tab.handles,
                       sizeof(gatts_handle_table_svc1));
                esp_ble_gatts_start_service(param->add_attr_tab.handles[0]);
                s_services_started++;
                try_start_advertising();
                ESP_LOGI(TAG, "Service 1 (My Service) started");
            }
            break;
        default:
            ESP_LOGE(TAG, "Unknown svc_inst_id %d in CREAT_ATTR_TAB_EVT", param->add_attr_tab.svc_inst_id);
            break;
        }
        break;
    case ESP_GATTS_READ_EVT:
        handle_gatt_read(param);
        break;
    case ESP_GATTS_WRITE_EVT:
        handle_gatt_write(param);
        break;
    case ESP_GATTS_EXEC_WRITE_EVT:
        ESP_LOGI(TAG, "EXEC_WRITE_EVT conn_id %d, trans_id %" PRIu32,
                 param->exec_write.conn_id, param->exec_write.trans_id);
        break;
    case ESP_GATTS_CONNECT_EVT:
        ESP_LOGI(TAG, "CONNECT_EVT conn_id %d", param->connect.conn_id);
        break;
    case ESP_GATTS_DISCONNECT_EVT:
        ESP_LOGI(TAG, "DISCONNECT_EVT conn_id %d, reason 0x%x",
                 param->disconnect.conn_id, param->disconnect.reason);
        /* Restart advertising after disconnect */
        s_adv_config_done = ADV_CONFIG_FLAG | SCAN_RSP_CONFIG_FLAG; /* already configured */
        s_advertising_started = 1;
        esp_ble_gap_start_advertising(&adv_params);
        break;
    default:
        break;
    }
}

/* ── Advertising Parameters (definition) ── */
static void init_adv_data(void) {
    s_adv_config_done = 0;
    s_services_started = 0;
    s_advertising_started = 0;
    adv_params.adv_int_min       = 160;
    adv_params.adv_int_max       = 320;
    adv_params.adv_type          = ADV_TYPE_IND;
    adv_params.own_addr_type     = BLE_ADDR_TYPE_PUBLIC;
    adv_params.channel_map       = ADV_CHNL_ALL;
    adv_params.adv_filter_policy = ADV_FILTER_ALLOW_SCAN_ANY_CON_ANY;

    /* Primary advertising payload: flags + device name (shortened) */
    memset(&adv_data, 0, sizeof(adv_data));
    adv_data.set_scan_rsp        = false;
    adv_data.include_name        = false;
    adv_data.include_txpower     = true;
    adv_data.min_interval        = 160;
    adv_data.max_interval        = 320;
    adv_data.appearance          = 0x0000;
    adv_data.manufacturer_len    = 0;
    adv_data.p_manufacturer_data = NULL;
    adv_data.service_data_len    = 0;
    adv_data.p_service_data      = NULL;
    adv_data.service_uuid_len    = 0;
    adv_data.p_service_uuid      = NULL;
    adv_data.flag = (ESP_BLE_ADV_FLAG_GEN_DISC | ESP_BLE_ADV_FLAG_BREDR_NOT_SPT);

    /* Scan response: repeat name in full so scanners see it */
    memset(&scan_rsp_data, 0, sizeof(scan_rsp_data));
    scan_rsp_data.set_scan_rsp        = true;
    scan_rsp_data.include_name        = true;
    scan_rsp_data.include_txpower     = false;
    scan_rsp_data.manufacturer_len    = 0;
    scan_rsp_data.p_manufacturer_data = NULL;
    scan_rsp_data.service_data_len    = 0;
    scan_rsp_data.p_service_data      = NULL;
    scan_rsp_data.service_uuid_len    = 0;
    scan_rsp_data.p_service_uuid      = NULL;
}

/* ── GAP Event Handler ── */
static void gap_event_handler(esp_gap_ble_cb_event_t event,
                               esp_ble_gap_cb_param_t *param) {
    switch (event) {
    case ESP_GAP_BLE_ADV_DATA_SET_COMPLETE_EVT:
        s_adv_config_done |= ADV_CONFIG_FLAG;
        try_start_advertising();
        break;
    case ESP_GAP_BLE_SCAN_RSP_DATA_SET_COMPLETE_EVT:
        s_adv_config_done |= SCAN_RSP_CONFIG_FLAG;
        try_start_advertising();
        break;
    case ESP_GAP_BLE_ADV_START_COMPLETE_EVT:
        if (param->adv_start_cmpl.status != ESP_BT_STATUS_SUCCESS) {
            s_advertising_started = 0;
            ESP_LOGE(TAG, "Advertising start failed, status %d", param->adv_start_cmpl.status);
        } else {
            ESP_LOGI(TAG, "Advertising started successfully");
        }
        break;
    case ESP_GAP_BLE_ADV_STOP_COMPLETE_EVT:
        if (param->adv_stop_cmpl.status != ESP_BT_STATUS_SUCCESS) {
            ESP_LOGE(TAG, "Advertising stop failed, status %d", param->adv_stop_cmpl.status);
        } else {
            s_advertising_started = 0;
        }
        break;
    case ESP_GAP_BLE_UPDATE_CONN_PARAMS_EVT:
        ESP_LOGI(TAG, "Connection params update: status %d, min_int %d, max_int %d, latency %d, timeout %d",
                 param->update_conn_params.status, param->update_conn_params.min_int,
                 param->update_conn_params.max_int, param->update_conn_params.latency,
                 param->update_conn_params.timeout);
        break;
    default: break;
    }
}

/* ── app_main ── */
void app_main(void) {
    esp_err_t ret;

    /* NVS must be initialised before BT — required for RF cal data & BT config */
    ret = nvs_flash_init();
    if (ret == ESP_ERR_NVS_NO_FREE_PAGES || ret == ESP_ERR_NVS_NEW_VERSION_FOUND) {
        ESP_ERROR_CHECK(nvs_flash_erase());
        ret = nvs_flash_init();
    }
    ESP_ERROR_CHECK(ret);

    ESP_ERROR_CHECK(esp_bt_controller_mem_release(ESP_BT_MODE_CLASSIC_BT));

    esp_bt_controller_config_t bt_cfg = BT_CONTROLLER_INIT_CONFIG_DEFAULT();
    ret = esp_bt_controller_init(&bt_cfg);
    if (ret) { ESP_LOGE(TAG, "bt_controller_init failed: %s", esp_err_to_name(ret)); return; }

    ret = esp_bt_controller_enable(ESP_BT_MODE_BLE);
    if (ret) { esp_bt_controller_deinit(); return; }

    ret = esp_bluedroid_init();
    if (ret) { esp_bt_controller_disable(); esp_bt_controller_deinit(); return; }

    ret = esp_bluedroid_enable();
    if (ret) { esp_bluedroid_deinit(); esp_bt_controller_disable(); esp_bt_controller_deinit(); return; }

    ESP_ERROR_CHECK(esp_ble_gatts_register_callback(gatts_event_handler));
    ESP_ERROR_CHECK(esp_ble_gap_register_callback(gap_event_handler));
    ESP_ERROR_CHECK(esp_ble_gatts_app_register(APP_ID));

    esp_ble_gatt_set_local_mtu(500);
    esp_ble_tx_power_set(ESP_BLE_PWR_TYPE_ADV, ESP_PWR_LVL_P9);

    /* GAP handler starts advertising after adv and scan response data are ready. */
    ESP_LOGI(TAG, "BLE init done; advertising will start after GATTS registration.");
}

/* ── End of generated file ── */